VERSION ""

BU_: Vector__XXX

BO_ 2499624702 A1SCREGT: 8 Vector__XXX
 SG_ Aftrtrtmnt1SCRCtlystIntkGasTemp : 0|16@1+ (0.03125,-273) [-273|1734.96875] "deg C" Vector__XXX

BO_ 2565869137 AT1IG1: 8 Vector__XXX
 SG_ Aftertreatment1IntakeNOx : 0|16@1+ (0.05,-200) [-200|3012.75] "ppm"  Vector__XXX

BO_ 2565869394 AT1OG1: 8 Vector__XXX
 SG_ Aftertreatment1OutletNOx : 0|16@1+ (0.05,-200) [-200|3012.75] "ppm"  Vector__XXX

BO_ 2566840318 EEC3: 8 Vector__XXX
 SG_ Aftrtratment1ExhaustGasMassFlow : 40|16@1+ (0.2,0) [0|12851] "kg/h" Vector__XXX
 SG_ NominalFrictionPercentTorque : 0|8@1+ (1,-125) [0|125] "%" Vector__XXX

BO_ 2566845696 AMB_ECM: 8 Vector__XXX
 SG_ AmbientAirTemp : 24|16@1+ (0.03125,-273) [-273|1734.96875] "deg C"  Vector__XXX
 SG_ BarometricPress : 0|8@1+ (0.5,0) [0|125] "kPa"  Vector__XXX

BO_ 2566844158 ET1: 8 Vector__XXX
 SG_ EngCoolantTemp : 0|8@1+ (1,-40) [-40|210] "deg C" Vector__XXX

BO_ 2364539902 EEC2: 8 Vector__XXX
 SG_ EngPercentLoadAtCurrentSpeed : 16|8@1+ (1,0) [0|250] "%" Vector__XXX

BO_ 2566841342 EC1: 39 Vector__XXX
 SG_ EngReferenceTorque : 152|16@1+ (1,0) [0|64255] "Nm" Vector__XXX
 SG_ EngPercentTorqueAtPoint2 : 40|8@1+ (1,-125) [-125|125] "%" Vector__XXX
 SG_ EngSpeedAtPoint2 : 24|16@1+ (0.125,0) [0|8031.875] "rpm" Vector__XXX
 SG_ EngPercentTorqueAtIdlePoint1 : 16|8@1+ (1,-125) [-125|125] "%" Vector__XXX
 SG_ EngSpeedAtIdlePoint1 : 0|16@1+ (0.125,0) [0|8031.875] "rpm" Vector__XXX

BO_ 2364540158 EEC1: 8 Vector__XXX
 SG_ EngSpeed : 24|16@1+ (0.125,0) [0|8031.875] "rpm" Vector__XXX
 SG_ ActualEngPercentTorque : 16|8@1+ (1,-125) [0|125] "%" Vector__XXX

BO_ 2566764798 DM26: 8 Vector__XXX
 SG_ TimeSinceEngineStart : 0|16@1+ (1,0) [0|64255] "sec" Vector__XXX

BO_ 2566834694 DM1_LMFS: 64 Vector__XXX
 SG_ FlashRedStopLamp : 12|2@1+ (1,0) [0|3] ""  Vector__XXX
 SG_ FlashProtectLamp : 8|2@1+ (1,0) [0|3] ""  Vector__XXX
 SG_ FlashMalfuncIndicatorLamp : 14|2@1+ (1,0) [0|3] ""  Vector__XXX
 SG_ FlashAmberWarningLamp : 10|2@1+ (1,0) [0|3] ""  Vector__XXX
 SG_ MalfunctionIndicatorLampStatus : 6|2@1+ (1,0) [0|3] ""  Vector__XXX
 SG_ AmberWarningLampStatus : 2|2@1+ (1,0) [0|3] ""  Vector__XXX
 SG_ RedStopLampState : 4|2@1+ (1,0) [0|3] ""  Vector__XXX
 SG_ ProtectLampStatus : 0|2@1+ (1,0) [0|3] ""  Vector__XXX
